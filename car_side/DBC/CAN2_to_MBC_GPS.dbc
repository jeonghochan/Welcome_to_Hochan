VERSION ""

NS_ :

BS_:

BU_: MBC_GPS VDCL_PC

BO_ 291 ROS_TX: 2 VDCL_PC
 SG_ VEH_SPD_KPH : 0|14@1+ (0.031,0) [0|507.873] "" Vector__XXX
 SG_ VEH_GEAR_REV : 14|2@1+ (1,0) [0|1] "" Vector__XXX

BA_DEF_  "DBName" STRING ;
BA_DEF_  "BusType" STRING ;
BA_DEF_ BO_  "VFrameFormat" ENUM  "StandardCAN","ExtendedCAN","reserved","J1939PG","reserved","reserved","reserved","reserved","reserved","reserved","reserved","reserved","reserved","reserved","StandardCAN_FD","ExtendedCAN_FD";
BA_DEF_ BO_  "GenMsgSendType" ENUM  "Cyclic","Event","CyclicIfActive","SpontanWithDelay","CyclicAndSpontan","CyclicAndSpontanWithDelay";
BA_DEF_DEF_  "DBName" "Cluster";
BA_DEF_DEF_  "BusType" "CAN";
BA_DEF_DEF_  "VFrameFormat" "StandardCAN";
BA_DEF_DEF_  "GenMsgSendType" "Cyclic";
BA_ "GenMsgSendType" BO_ 291 1;
