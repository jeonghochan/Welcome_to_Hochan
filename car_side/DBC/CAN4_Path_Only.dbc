VERSION ""

NS_ :

BS_ :

BU_ :

BO_ 1024 AliveCounter: 8 Vector__XXX
  SG_ Alive_Counter : 0|32@1- (0.001,0) [0|0] "" Vector__XXX

BO_ 1025 Path_x1: 8 Vector__XXX
  SG_ x01 : 0|32@1- (0.001,0) [0|0] "" Vector__XXX
  SG_ x02 : 32|32@1- (0.001,0) [0|0] "" Vector__XXX

BO_ 1040 Path_x10: 8 Vector__XXX
  SG_ x19 : 0|32@1- (0.001,0) [0|0] "" Vector__XXX
  SG_ x20 : 32|32@1- (0.001,0) [0|0] "" Vector__XXX

BO_ 1026 Path_x2: 8 Vector__XXX
  SG_ x03 : 0|32@1- (0.001,0) [0|0] "" Vector__XXX
  SG_ x04 : 32|32@1- (0.001,0) [0|0] "" Vector__XXX

BO_ 1027 Path_x3: 8 Vector__XXX
  SG_ x05 : 0|32@1- (0.001,0) [0|0] "" Vector__XXX
  SG_ x06 : 32|32@1- (0.001,0) [0|0] "" Vector__XXX

BO_ 1028 Path_x4: 8 Vector__XXX
  SG_ x07 : 0|32@1- (0.001,0) [0|0] "" Vector__XXX
  SG_ x08 : 32|32@1- (0.001,0) [0|0] "" Vector__XXX

BO_ 1029 Path_x5: 8 Vector__XXX
  SG_ x09 : 0|32@1- (0.001,0) [0|0] "" Vector__XXX
  SG_ x10 : 32|32@1- (0.001,0) [0|0] "" Vector__XXX

BO_ 1030 Path_x6: 8 Vector__XXX
  SG_ x11 : 0|32@1- (0.001,0) [0|0] "" Vector__XXX
  SG_ x12 : 32|32@1- (0.001,0) [0|0] "" Vector__XXX

BO_ 1031 Path_x7: 8 Vector__XXX
  SG_ x13 : 0|32@1- (0.001,0) [0|0] "" Vector__XXX
  SG_ x14 : 32|32@1- (0.001,0) [0|0] "" Vector__XXX

BO_ 1032 Path_x8: 8 Vector__XXX
  SG_ x15 : 0|32@1- (0.001,0) [0|0] "" Vector__XXX
  SG_ x16 : 32|32@1- (0.001,0) [0|0] "" Vector__XXX

BO_ 1033 Path_x9: 8 Vector__XXX
  SG_ x17 : 0|32@1- (0.001,0) [0|0] "" Vector__XXX
  SG_ x18 : 32|32@1- (0.001,0) [0|0] "" Vector__XXX

BO_ 1041 Path_y1: 8 Vector__XXX
  SG_ y01 : 0|32@1- (0.001,0) [0|0] "" Vector__XXX
  SG_ y02 : 32|32@1- (0.001,0) [0|0] "" Vector__XXX

BO_ 1056 Path_y10: 8 Vector__XXX
  SG_ y19 : 0|32@1- (0.001,0) [0|0] "" Vector__XXX
  SG_ y20 : 32|32@1- (0.001,0) [0|0] "" Vector__XXX

BO_ 1042 Path_y2: 8 Vector__XXX
  SG_ y03 : 0|32@1- (0.001,0) [0|0] "" Vector__XXX
  SG_ y04 : 32|32@1- (0.001,0) [0|0] "" Vector__XXX

BO_ 1043 Path_y3: 8 Vector__XXX
  SG_ y05 : 0|32@1- (0.001,0) [0|0] "" Vector__XXX
  SG_ y06 : 32|32@1- (0.001,0) [0|0] "" Vector__XXX

BO_ 1044 Path_y4: 8 Vector__XXX
  SG_ y07 : 0|32@1- (0.001,0) [0|0] "" Vector__XXX
  SG_ y08 : 32|32@1- (0.001,0) [0|0] "" Vector__XXX

BO_ 1045 Path_y5: 8 Vector__XXX
  SG_ y09 : 0|32@1- (0.001,0) [0|0] "" Vector__XXX
  SG_ y10 : 32|32@1- (0.001,0) [0|0] "" Vector__XXX

BO_ 1046 Path_y6: 8 Vector__XXX
  SG_ y11 : 0|32@1- (0.001,0) [0|0] "" Vector__XXX
  SG_ y12 : 32|32@1- (0.001,0) [0|0] "" Vector__XXX

BO_ 1047 Path_y7: 8 Vector__XXX
  SG_ y13 : 0|32@1- (0.001,0) [0|0] "" Vector__XXX
  SG_ y14 : 32|32@1- (0.001,0) [0|0] "" Vector__XXX

BO_ 1048 Path_y8: 8 Vector__XXX
  SG_ y15 : 0|32@1- (0.001,0) [0|0] "" Vector__XXX
  SG_ y16 : 32|32@1- (0.001,0) [0|0] "" Vector__XXX

BO_ 1049 Path_y9: 8 Vector__XXX
  SG_ y17 : 0|32@1- (0.001,0) [0|0] "" Vector__XXX
  SG_ y18 : 32|32@1- (0.001,0) [0|0] "" Vector__XXX

BA_DEF_ "DBName" STRING;
BA_DEF_ "BusType" STRING;
BA_DEF_ BO_ "VFrameFormat" ENUM "StandardCAN","ExtendedCAN","reserved","J1939PG","reserved","reserved","reserved","reserved","reserved","reserved","reserved","reserved","reserved","reserved","StandardCAN_FD","ExtendedCAN_FD";
BA_DEF_ BO_ "GenMsgSendType" ENUM "Cyclic","Event","CyclicIfActive","SpontanWithDelay","CyclicAndSpontan","CyclicAndSpontanWithDelay";
BA_DEF_DEF_ "DBName" "Cluster";
BA_DEF_DEF_ "BusType" "CAN";
BA_DEF_DEF_ "VFrameFormat" "StandardCAN";
BA_DEF_DEF_ "GenMsgSendType" "Cyclic";
BA_ "GenMsgSendType" BO_ 1024 1;
BA_ "GenMsgSendType" BO_ 1025 1;
BA_ "GenMsgSendType" BO_ 1040 1;
BA_ "GenMsgSendType" BO_ 1026 1;
BA_ "GenMsgSendType" BO_ 1027 1;
BA_ "GenMsgSendType" BO_ 1028 1;
BA_ "GenMsgSendType" BO_ 1029 1;
BA_ "GenMsgSendType" BO_ 1030 1;
BA_ "GenMsgSendType" BO_ 1031 1;
BA_ "GenMsgSendType" BO_ 1032 1;
BA_ "GenMsgSendType" BO_ 1033 1;
BA_ "GenMsgSendType" BO_ 1041 1;
BA_ "GenMsgSendType" BO_ 1056 1;
BA_ "GenMsgSendType" BO_ 1042 1;
BA_ "GenMsgSendType" BO_ 1043 1;
BA_ "GenMsgSendType" BO_ 1044 1;
BA_ "GenMsgSendType" BO_ 1045 1;
BA_ "GenMsgSendType" BO_ 1046 1;
BA_ "GenMsgSendType" BO_ 1047 1;
BA_ "GenMsgSendType" BO_ 1048 1;
BA_ "GenMsgSendType" BO_ 1049 1;
